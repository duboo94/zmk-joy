## config/west.yml
```yaml
manifest:
  remotes:
    - name: duboo94
      url-base: https://github.com/duboo94
    - name: badjeff
      url-base: https://github.com/badjeff
    - name: heinn-dev
      url-base: https://github.com/heinn-dev
    - name: nuovotaka
      url-base: https://github.com/nuovotaka
      
  projects:
    - name: zmk
      remote: duboo94
      revision: main
      import: app/west.yml
    - name: zmk-analog-input-driver
      remote: badjeff
      revision: main
    - name: zmk-pointing-acceleration-alpha
      remote: nuovotaka
      revision: main
      
  self:
    path: config
```
